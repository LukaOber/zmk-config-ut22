## config/west.yml
```yaml
manifest:
  remotes:
    # zmk official
    - name: zmkfirmware
      url-base: https://github.com/zmkfirmware
    # - name: Nicell
    #   url-base: https://github.com/Nicell
  projects:
    - name: zmk
      remote: zmkfirmware
      revision: main
      import: app/west.yml
  #   - name: zmk
  #     remote: Nicell
  #     revision: nice-view-custom-screen
  #     import: app/west.yml
  self:
    path: config
```
